## br2-external/Config.in
```kconfig
menu "CustomOS packages"
source "$BR2_EXTERNAL_CUSTOMOS_PATH/package/extra-cmake-modules/Config.in"
source "$BR2_EXTERNAL_CUSTOMOS_PATH/package/layer-shell-qt/Config.in"
source "$BR2_EXTERNAL_CUSTOMOS_PATH/package/libsfdo/Config.in"
source "$BR2_EXTERNAL_CUSTOMOS_PATH/package/labwc/Config.in"
source "$BR2_EXTERNAL_CUSTOMOS_PATH/package/swaylock/Config.in"
source "$BR2_EXTERNAL_CUSTOMOS_PATH/package/grim/Config.in"
source "$BR2_EXTERNAL_CUSTOMOS_PATH/package/meridian-desktop/Config.in"
endmenu
```

## br2-external/configs/customos_x86_64_ota_defconfig
```kconfig
# CustomOS x86_64 with over-the-air updates: the live/installable ISO of
# customos_x86_64_defconfig plus the A/B update system (RAUC, customos-updater,
# a squashfs system image for the A/B installer and the update bundles).
# Build: ./build.sh --ota   (or: make BR2_EXTERNAL=../br2-external customos_x86_64_ota_defconfig && make)
#
# Keep the shared part identical to customos_x86_64_defconfig
# (tests/check-buildroot-config.sh verifies it); OTA additions are at the end and
# marked "OTA:".

# ---- Architecture and toolchain ---------------------------------------------
BR2_x86_64=y
BR2_x86_x86_64_v2=y
BR2_TOOLCHAIN_EXTERNAL=y
BR2_TOOLCHAIN_EXTERNAL_BOOTLIN=y
BR2_TOOLCHAIN_EXTERNAL_BOOTLIN_X86_64_V2_GLIBC_STABLE=y
BR2_CCACHE=y
BR2_REPRODUCIBLE=y
# Fixes for Buildroot's own packages: br2-external/patches/<package>/<version>/
BR2_GLOBAL_PATCH_DIR="$(BR2_EXTERNAL_CUSTOMOS_PATH)/patches"

# ---- System ------------------------------------------------------------------
BR2_TARGET_GENERIC_HOSTNAME="customos"
BR2_TARGET_GENERIC_ISSUE="CustomOS 1.0"
BR2_TARGET_GENERIC_PASSWD_SHA512=y
BR2_INIT_SYSTEMD=y
BR2_PACKAGE_SYSTEMD_DEFAULT_TARGET="graphical.target"
BR2_ROOTFS_MERGED_USR=y
BR2_SYSTEM_BIN_SH_BASH=y
BR2_TARGET_GENERIC_GETTY_PORT="tty2"
BR2_TARGET_GENERIC_ROOT_PASSWD=""
BR2_ENABLE_LOCALE_WHITELIST="C en_US"
BR2_GENERATE_LOCALE="en_US.UTF-8"
BR2_TARGET_TZ_INFO=y
BR2_TARGET_LOCALTIME="Etc/UTC"
BR2_ROOTFS_USERS_TABLES="$(BR2_EXTERNAL_CUSTOMOS_PATH)/board/customos/users.txt"
BR2_ROOTFS_OVERLAY="$(BR2_EXTERNAL_CUSTOMOS_PATH)/board/customos/rootfs-overlay"
BR2_ROOTFS_POST_BUILD_SCRIPT="$(BR2_EXTERNAL_CUSTOMOS_PATH)/board/customos/post-build.sh"
# OTA: post-image-ota.sh adds the system image to the ISO
BR2_ROOTFS_POST_IMAGE_SCRIPT="$(BR2_EXTERNAL_CUSTOMOS_PATH)/board/customos/post-image.sh $(BR2_EXTERNAL_CUSTOMOS_PATH)/board/customos/ota/post-image-ota.sh"

# ---- Kernel ------------------------------------------------------------------
BR2_LINUX_KERNEL=y
BR2_LINUX_KERNEL_LATEST_VERSION=y
BR2_LINUX_KERNEL_USE_ARCH_DEFAULT_CONFIG=y
# OTA: dm-verity, squashfs xz, watchdogs
BR2_LINUX_KERNEL_CONFIG_FRAGMENT_FILES="$(BR2_EXTERNAL_CUSTOMOS_PATH)/board/customos/linux.fragment $(BR2_EXTERNAL_CUSTOMOS_PATH)/board/customos/ota/linux-ota.fragment"
BR2_LINUX_KERNEL_BZIMAGE=y
BR2_LINUX_KERNEL_INSTALL_TARGET=y
BR2_LINUX_KERNEL_NEEDS_HOST_OPENSSL=y
BR2_LINUX_KERNEL_NEEDS_HOST_LIBELF=y
BR2_PACKAGE_LINUX_FIRMWARE=y
BR2_PACKAGE_LINUX_FIRMWARE_RTL_81XX=y
BR2_PACKAGE_LINUX_FIRMWARE_RTL_8169=y
BR2_PACKAGE_LINUX_FIRMWARE_IWLWIFI_8265=y
BR2_PACKAGE_LINUX_FIRMWARE_IWLWIFI_9XXX=y
BR2_PACKAGE_WIRELESS_REGDB=y

# ---- systemd -----------------------------------------------------------------
BR2_PACKAGE_SYSTEMD_LOGIND=y
BR2_PACKAGE_SYSTEMD_POLKIT=y
BR2_PACKAGE_SYSTEMD_HOSTNAMED=y
BR2_PACKAGE_SYSTEMD_TIMEDATED=y
BR2_PACKAGE_SYSTEMD_TIMESYNCD=y
BR2_PACKAGE_SYSTEMD_LOCALED=y
BR2_PACKAGE_SYSTEMD_HWDB=y
BR2_PACKAGE_SYSTEMD_SYSUSERS=y
BR2_PACKAGE_SYSTEMD_FIRSTBOOT=y
BR2_PACKAGE_SYSTEMD_VCONSOLE=y
BR2_PACKAGE_SYSTEMD_RESOLVED=y

# ---- Graphics stack ------------------------------------------------------------
BR2_PACKAGE_MESA3D=y
BR2_PACKAGE_MESA3D_LLVM=y
BR2_PACKAGE_MESA3D_GALLIUM_DRIVER_LLVMPIPE=y
BR2_PACKAGE_MESA3D_GALLIUM_DRIVER_SVGA=y
BR2_PACKAGE_MESA3D_GALLIUM_DRIVER_VIRGL=y
BR2_PACKAGE_MESA3D_GBM=y
BR2_PACKAGE_MESA3D_OPENGL_EGL=y
BR2_PACKAGE_MESA3D_OPENGL_ES=y
BR2_PACKAGE_LIBDRM=y
BR2_PACKAGE_LIBINPUT=y
BR2_PACKAGE_SEATD=y
BR2_PACKAGE_WAYLAND=y
BR2_PACKAGE_WAYLAND_PROTOCOLS=y
BR2_PACKAGE_WLROOTS=y
BR2_PACKAGE_XKEYBOARD_CONFIG=y
BR2_PACKAGE_PSPLASH=y
BR2_PACKAGE_PSPLASH_IMAGE="$(BR2_EXTERNAL_CUSTOMOS_PATH)/board/customos/splash.png"
BR2_PACKAGE_PSPLASH_PROGRESS_BAR=y

# ---- Qt 6 ------------------------------------------------------------------------
BR2_PACKAGE_QT6=y
BR2_PACKAGE_QT6BASE_GUI=y
BR2_PACKAGE_QT6BASE_OPENGL=y
BR2_PACKAGE_QT6BASE_OPENGL_ES2=y
BR2_PACKAGE_QT6BASE_LINUXFB=y
BR2_PACKAGE_QT6BASE_EGLFS=y
BR2_PACKAGE_QT6BASE_DEFAULT_QPA="wayland"
BR2_PACKAGE_QT6BASE_FONTCONFIG=y
BR2_PACKAGE_QT6BASE_HARFBUZZ=y
BR2_PACKAGE_QT6BASE_PNG=y
BR2_PACKAGE_QT6BASE_JPEG=y
BR2_PACKAGE_QT6BASE_DBUS=y
BR2_PACKAGE_QT6BASE_NETWORK=y
BR2_PACKAGE_QT6BASE_CONCURRENT=y
BR2_PACKAGE_QT6BASE_XML=y
BR2_PACKAGE_QT6DECLARATIVE=y
BR2_PACKAGE_QT6DECLARATIVE_QUICK=y
BR2_PACKAGE_QT6SVG=y
BR2_PACKAGE_QT6WAYLAND=y
BR2_PACKAGE_QT6SHADERTOOLS=y

# ---- Desktop -----------------------------------------------------------------------
BR2_PACKAGE_MERIDIAN_DESKTOP=y
BR2_PACKAGE_LABWC=y
BR2_PACKAGE_LAYER_SHELL_QT=y
BR2_PACKAGE_SWAYLOCK=y
BR2_PACKAGE_GRIM=y
BR2_PACKAGE_FOOT=y
BR2_PACKAGE_WLR_RANDR=y
BR2_PACKAGE_HICOLOR_ICON_THEME=y
BR2_PACKAGE_SHARED_MIME_INFO=y
BR2_PACKAGE_FONTCONFIG=y
BR2_PACKAGE_DEJAVU=y
BR2_PACKAGE_DBUS=y

# ---- Audio -------------------------------------------------------------------------
BR2_PACKAGE_ALSA_LIB=y
BR2_PACKAGE_ALSA_UTILS=y
BR2_PACKAGE_LUA=y
BR2_PACKAGE_LUA_5_4=y
BR2_PACKAGE_PIPEWIRE=y
BR2_PACKAGE_WIREPLUMBER=y

# ---- Networking ------------------------------------------------------------------
BR2_PACKAGE_NETWORK_MANAGER=y
BR2_PACKAGE_NETWORK_MANAGER_CLI=y
BR2_PACKAGE_WPA_SUPPLICANT=y
BR2_PACKAGE_WPA_SUPPLICANT_NL80211=y
BR2_PACKAGE_WPA_SUPPLICANT_DBUS=y
BR2_PACKAGE_IPROUTE2=y
BR2_PACKAGE_IPUTILS=y
BR2_PACKAGE_CA_CERTIFICATES=y

# ---- Security / accounts -------------------------------------------------------
BR2_PACKAGE_LINUX_PAM=y
BR2_PACKAGE_LIBXCRYPT=y
BR2_PACKAGE_SHADOW=y
BR2_PACKAGE_SHADOW_SHA_CRYPT=y
BR2_PACKAGE_SUDO=y
BR2_PACKAGE_POLKIT=y

# ---- Base utilities and installer tools -------------------------------------------
BR2_PACKAGE_BASH=y
BR2_PACKAGE_COREUTILS=y
BR2_PACKAGE_FINDUTILS=y
BR2_PACKAGE_GREP=y
BR2_PACKAGE_SED=y
BR2_PACKAGE_GAWK=y
BR2_PACKAGE_LESS=y
BR2_PACKAGE_NANO=y
BR2_PACKAGE_HTOP=y
BR2_PACKAGE_PROCPS_NG=y
BR2_PACKAGE_PSMISC=y
BR2_PACKAGE_KBD=y
BR2_PACKAGE_PCIUTILS=y
BR2_PACKAGE_USBUTILS=y
BR2_PACKAGE_UTIL_LINUX=y
BR2_PACKAGE_UTIL_LINUX_BINARIES=y
BR2_PACKAGE_UTIL_LINUX_MOUNT=y
BR2_PACKAGE_UTIL_LINUX_MOUNTPOINT=y
BR2_PACKAGE_UTIL_LINUX_PARTX=y
BR2_PACKAGE_UTIL_LINUX_WIPEFS=y
BR2_PACKAGE_UTIL_LINUX_AGETTY=y
BR2_PACKAGE_UTIL_LINUX_SU=y
BR2_PACKAGE_UTIL_LINUX_SULOGIN=y
BR2_PACKAGE_UTIL_LINUX_NOLOGIN=y
BR2_PACKAGE_UTIL_LINUX_KILL=y
BR2_PACKAGE_UTIL_LINUX_LOGIN=y
BR2_PACKAGE_E2FSPROGS=y
BR2_PACKAGE_DOSFSTOOLS=y
BR2_PACKAGE_DOSFSTOOLS_MKFS_FAT=y
BR2_PACKAGE_DOSFSTOOLS_FSCK_FAT=y
BR2_PACKAGE_GPTFDISK=y
BR2_PACKAGE_GPTFDISK_SGDISK=y
BR2_PACKAGE_PARTED=y
BR2_PACKAGE_RSYNC=y
BR2_PACKAGE_EFIBOOTMGR=y

# ---- Boot: ISO with GRUB for BIOS and UEFI ---------------------------------------
BR2_TARGET_GRUB2=y
BR2_TARGET_GRUB2_I386_PC=y
BR2_TARGET_GRUB2_X86_64_EFI=y
BR2_TARGET_GRUB2_BOOT_PARTITION="cd"
BR2_TARGET_GRUB2_BUILTIN_MODULES_PC="boot linux ext2 fat iso9660 part_msdos part_gpt normal biosdisk search search_fs_file configfile echo test reboot halt"
BR2_TARGET_GRUB2_BUILTIN_MODULES_EFI="boot linux ext2 fat iso9660 part_msdos part_gpt normal efi_gop search search_fs_file configfile echo test reboot halt"
BR2_TARGET_GRUB2_BUILTIN_CONFIG_EFI="$(BR2_EXTERNAL_CUSTOMOS_PATH)/board/customos/grub-efi-embedded.cfg"
BR2_TARGET_GRUB2_INSTALL_TOOLS=y
BR2_TARGET_ROOTFS_ISO9660=y
BR2_TARGET_ROOTFS_ISO9660_GRUB2=y
BR2_TARGET_ROOTFS_ISO9660_BOOT_MENU="$(BR2_EXTERNAL_CUSTOMOS_PATH)/board/customos/grub.cfg"
BR2_TARGET_ROOTFS_ISO9660_INITRD=y
BR2_TARGET_ROOTFS_CPIO=y
BR2_TARGET_ROOTFS_CPIO_ZSTD=y
# BR2_TARGET_ROOTFS_TAR is not set
BR2_PACKAGE_HOST_DOSFSTOOLS=y
BR2_PACKAGE_HOST_MTOOLS=y
BR2_PACKAGE_HOST_XORRISO=y

# ---- OTA: over-the-air updates (A/B layout) ----------------------------------------
BR2_PACKAGE_CUSTOMOS_UPDATER=y
BR2_PACKAGE_CUSTOMOS_UPDATER_REPOSITORY="UralGames/CustomOs"
BR2_PACKAGE_OPENSSL=y
# TLS for the update downloads (Qt Network). Buildroot's defaults keep SSLv3,
# weak ciphers and debug code; none of it is needed.
# BR2_PACKAGE_LIBOPENSSL_ENABLE_SSL is not set
# BR2_PACKAGE_LIBOPENSSL_ENABLE_SSL3 is not set
# BR2_PACKAGE_LIBOPENSSL_ENABLE_WEAK_SSL is not set
# BR2_PACKAGE_LIBOPENSSL_UNSECURE is not set
BR2_PACKAGE_RAUC=y
BR2_PACKAGE_RAUC_DBUS=y
BR2_PACKAGE_RAUC_JSON=y
# The system image: written to the A/B slots by the installer and carried by
# the update bundles.
BR2_TARGET_ROOTFS_SQUASHFS=y
BR2_TARGET_ROOTFS_SQUASHFS4_XZ=y
# Bundle creation and signing (release/make-release.sh).
BR2_PACKAGE_HOST_RAUC=y
```

## br2-external/package/customos-updater/Config.in
```kconfig
config BR2_PACKAGE_CUSTOMOS_UPDATER
	bool "customos-updater"
	depends on BR2_PACKAGE_QT6
	depends on BR2_INIT_SYSTEMD
	depends on BR2_TOOLCHAIN_HAS_THREADS # rauc -> glib2
	depends on BR2_USE_MMU # rauc -> glib2
	depends on BR2_USE_WCHAR # rauc -> glib2
	depends on BR2_TARGET_GRUB2_INSTALL_TOOLS # grub-editenv, grub-install
	select BR2_PACKAGE_QT6BASE_NETWORK
	select BR2_PACKAGE_QT6BASE_DBUS
	# Qt's TLS backend: GitHub is only reachable over HTTPS.
	select BR2_PACKAGE_OPENSSL
	select BR2_PACKAGE_CA_CERTIFICATES
	select BR2_PACKAGE_RAUC
	select BR2_PACKAGE_RAUC_DBUS
	select BR2_PACKAGE_RAUC_JSON
	select BR2_PACKAGE_BASH # boot and installer scripts
	select BR2_PACKAGE_UTIL_LINUX
	select BR2_PACKAGE_UTIL_LINUX_BINARIES # blkid, lsblk
	select BR2_PACKAGE_UTIL_LINUX_MOUNT
	select BR2_PACKAGE_UTIL_LINUX_MOUNTPOINT
	select BR2_PACKAGE_E2FSPROGS # e2fsck, mkfs.ext4 for the data partition
	select BR2_PACKAGE_GPTFDISK # installer
	select BR2_PACKAGE_GPTFDISK_SGDISK
	select BR2_PACKAGE_DOSFSTOOLS
	select BR2_PACKAGE_DOSFSTOOLS_MKFS_FAT
	select BR2_PACKAGE_SHADOW # useradd in the installer
	help
	  Over-the-air updates for CustomOS from GitHub Releases:
	  the customos-updated service and customos-update command,
	  the A/B boot integration (preinit, GRUB menu, health check,
	  RAUC configuration and hooks) and the A/B installer.

	  The Meridian Update user interface is part of
	  meridian-desktop.

if BR2_PACKAGE_CUSTOMOS_UPDATER

config BR2_PACKAGE_CUSTOMOS_UPDATER_REPOSITORY
	string "GitHub repository with the releases"
	default "UralGames/CustomOs"
	help
	  "owner/name" (or https://github.com/owner/name) of the
	  repository whose GitHub Releases carry the update bundles.
	  Can be changed at run time in /etc/customos/update.conf.d/.

	  GitHub only serves release files of a private repository
	  with an access token; either publish releases from a public
	  repository or configure TokenFile on each system.

config BR2_PACKAGE_CUSTOMOS_UPDATER_COMPATIBLE
	string "RAUC compatible string"
	default "customos-x86_64-ab"
	help
	  Systems only accept bundles built for the same compatible.
	  Change it only together with the release workflow.

config BR2_PACKAGE_CUSTOMOS_UPDATER_CHANNEL
	string "release channel"
	default "stable"
	help
	  "stable": the newest GitHub release that is not marked as a
	  pre-release. ("beta", including pre-releases, is reserved
	  for later.)

config BR2_PACKAGE_CUSTOMOS_UPDATER_KEYRING
	string "trusted certificate (RAUC keyring)"
	default "$(BR2_EXTERNAL_CUSTOMOS_PATH)/../keys/customos-ota-ca.cert.pem"
	help
	  PEM file with the CA certificate that update bundles must be
	  signed with (created by release/keys/create-ota-keys.sh).
	  It is installed as /etc/rauc/keyring.pem. Only the public
	  certificate goes into the image; the private keys never do.

endif

comment "customos-updater needs Qt 6, systemd and GRUB with tools installed on the target"
	depends on !BR2_PACKAGE_QT6 || !BR2_INIT_SYSTEMD || !BR2_TARGET_GRUB2_INSTALL_TOOLS
```

## br2-external/package/extra-cmake-modules/Config.in
```kconfig
config BR2_PACKAGE_EXTRA_CMAKE_MODULES
	bool "extra-cmake-modules"
	help
	  KDE's extra CMake modules (ECM). Build-time only: installed
	  to the staging directory, nothing goes to the target.

	  https://invent.kde.org/frameworks/extra-cmake-modules
```

## br2-external/package/grim/Config.in
```kconfig
config BR2_PACKAGE_GRIM
	bool "grim"
	depends on BR2_PACKAGE_WAYLAND
	select BR2_PACKAGE_LIBPNG
	select BR2_PACKAGE_PIXMAN
	select BR2_PACKAGE_WAYLAND_PROTOCOLS
	help
	  Screenshot tool for Wayland compositors (wlr-screencopy).

	  https://gitlab.freedesktop.org/emersion/grim
```

## br2-external/package/labwc/Config.in
```kconfig
config BR2_PACKAGE_LABWC
	bool "labwc"
	depends on BR2_PACKAGE_WLROOTS
	depends on BR2_PACKAGE_HOST_RUSTC_TARGET_ARCH_SUPPORTS # librsvg
	select BR2_PACKAGE_CAIRO
	select BR2_PACKAGE_CAIRO_PNG
	select BR2_PACKAGE_LIBGLIB2
	select BR2_PACKAGE_LIBPNG
	select BR2_PACKAGE_LIBRSVG
	select BR2_PACKAGE_LIBSFDO
	select BR2_PACKAGE_LIBXML2
	select BR2_PACKAGE_PANGO
	select BR2_PACKAGE_XKEYBOARD_CONFIG # runtime keymaps
	help
	  labwc: a stacking Wayland compositor built on wlroots. It is
	  the window manager of the Meridian desktop (decorations,
	  snapping, virtual desktops, Alt+Tab, keyboard shortcuts).

	  https://labwc.github.io

comment "labwc needs wlroots"
	depends on !BR2_PACKAGE_WLROOTS
```

## br2-external/package/layer-shell-qt/Config.in
```kconfig
config BR2_PACKAGE_LAYER_SHELL_QT
	bool "layer-shell-qt"
	depends on BR2_PACKAGE_QT6
	depends on BR2_PACKAGE_QT6_GL_SUPPORTS # qt6wayland
	select BR2_PACKAGE_EXTRA_CMAKE_MODULES
	select BR2_PACKAGE_QT6WAYLAND
	select BR2_PACKAGE_QT6DECLARATIVE
	select BR2_PACKAGE_QT6DECLARATIVE_QUICK
	select BR2_PACKAGE_WAYLAND_PROTOCOLS
	select BR2_PACKAGE_LIBXKBCOMMON
	help
	  Qt integration of the wlr-layer-shell protocol, used by the
	  Meridian shell for its taskbar, wallpaper and panels.

	  https://invent.kde.org/plasma/layer-shell-qt
```

## br2-external/package/libsfdo/Config.in
```kconfig
config BR2_PACKAGE_LIBSFDO
	bool "libsfdo"
	help
	  Collection of freedesktop.org specification implementations
	  (desktop entries, icon themes). Used by labwc for window icons.

	  https://gitlab.freedesktop.org/vyivel/libsfdo
```

## br2-external/package/meridian-desktop/Config.in
```kconfig
config BR2_PACKAGE_MERIDIAN_DESKTOP
	bool "meridian-desktop"
	depends on BR2_PACKAGE_QT6
	depends on BR2_PACKAGE_QT6_GL_SUPPORTS
	depends on BR2_PACKAGE_SYSTEMD
	depends on (BR2_ENABLE_LOCALE && BR2_USE_WCHAR) # linux-pam
	depends on !BR2_STATIC_LIBS # linux-pam
	depends on BR2_USE_MMU # linux-pam
	depends on BR2_TOOLCHAIN_GCC_AT_LEAST_4_9 # linux-pam
	# Selected rather than depended on: "depends on" linux-pam plus
	# "select foot" formed a Kconfig dependency loop through
	# util-linux, piglit and wayland.
	select BR2_PACKAGE_LINUX_PAM
	select BR2_PACKAGE_QT6BASE_GUI
	select BR2_PACKAGE_QT6BASE_DBUS
	select BR2_PACKAGE_QT6BASE_NETWORK
	select BR2_PACKAGE_QT6BASE_LINUXFB # greeter
	select BR2_PACKAGE_QT6BASE_FONTCONFIG
	select BR2_PACKAGE_QT6BASE_PNG
	select BR2_PACKAGE_QT6BASE_JPEG
	select BR2_PACKAGE_QT6DECLARATIVE
	select BR2_PACKAGE_QT6DECLARATIVE_QUICK
	select BR2_PACKAGE_QT6SVG
	select BR2_PACKAGE_QT6WAYLAND
	select BR2_PACKAGE_LAYER_SHELL_QT
	select BR2_PACKAGE_LABWC
	select BR2_PACKAGE_SWAYLOCK
	select BR2_PACKAGE_GRIM
	select BR2_PACKAGE_FOOT
	select BR2_PACKAGE_WLR_RANDR
	help
	  The Meridian desktop: shell (taskbar, start menu, quick
	  settings, notifications), File Manager, Settings, System
	  Monitor, Text Editor, graphical sign-in and installer.
```
